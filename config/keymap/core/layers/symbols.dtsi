#ifdef LAYERS_SYMBOLS_ALTERTATIVE

ZMK_LAYER(sym,
// ╭──────────────────┬──────────────────┬──────────────────┬──────────────────┬──────────────────┬──────────────────╮   ╭──────────────────┬──────────────────┬──────────────────┬──────────────────┬──────────────────┬──────────────────╮
     ___                ___                &kp MINUS          &kp KP_DIVIDE      &kp EQUAL          ___                    ___                X_COLON            &kp STAR           &kp PLUS           ___                ___
// ├──────────────────├──────────────────┼──────────────────┼──────────────────┼──────────────────┼──────────────────┤   ├──────────────────├──────────────────┼──────────────────┼──────────────────┼──────────────────┼──────────────────┤
     ___                X_LESS             X_LBKT             X_LBRC             &kp LPAR           X_PIPE                 X_AMPS             &kp RPAR           X_RBRC             X_RBKT             X_GRT              X_SEMI 
// ├──────────────────├──────────────────┼──────────────────┼──────────────────┼──────────────────┼──────────────────┤   ├──────────────────├──────────────────┼──────────────────┼──────────────────┼──────────────────┼──────────────────┤
     ___                X_CARET            &kp EXCL           &kp HASH           &ht_at_email 0 0   ___                    ___                &kp PERCENT        X_TILDE            X_QST              X_DLLR             ___
// ╰──────────────────┴──────────────────┴──────────────────┼──────────────────┼──────────────────┼──────────────────┤   ├──────────────────├──────────────────┼──────────────────┼──────────────────┴──────────────────┴──────────────────╯
                                                              &mc_up_dir         ___                &kp BSLH               ___                ___                ___
//                                                          ╰──────────────────┴──────────────────┴──────────────────╯   ╰──────────────────┴──────────────────┴──────────────────╯
)

#else

ZMK_LAYER(sym,
// ╭──────────────────┬──────────────────┬──────────────────┬──────────────────┬──────────────────┬──────────────────╮   ╭──────────────────┬──────────────────┬──────────────────┬──────────────────┬──────────────────┬──────────────────╮
     ___                ___                &kp MINUS          &kp PLUS           &kp HASH           ___                    ___                X_TILDE            &kp KP_DIVIDE      &kp STAR           ___                ___
// ├──────────────────├──────────────────┼──────────────────┼──────────────────┼──────────────────┼──────────────────┤   ├──────────────────├──────────────────┼──────────────────┼──────────────────┼──────────────────┼──────────────────┤
     ___                &kp EXCL           &kp LPAR           &kp RPAR           &kp EQUAL          X_PIPE                 X_AMPS             X_COLON            X_LBRC             X_RBRC             X_QST              X_SEMI 
// ├──────────────────├──────────────────┼──────────────────┼──────────────────┼──────────────────┼──────────────────┤   ├──────────────────├──────────────────┼──────────────────┼──────────────────┼──────────────────┼──────────────────┤
     ___                X_CARET            X_LBKT             X_RBKT             &ht_at_email 0 0   ___                    ___                &kp PERCENT        X_LESS             X_GRT              X_DLLR             ___
// ╰──────────────────┴──────────────────┴──────────────────┼──────────────────┼──────────────────┼──────────────────┤   ├──────────────────├──────────────────┼──────────────────┼──────────────────┴──────────────────┴──────────────────╯
                                                              &mc_up_dir         ___                &kp BSLH               ___                ___                ___
//                                                          ╰──────────────────┴──────────────────┴──────────────────╯   ╰──────────────────┴──────────────────┴──────────────────╯
)

#endif
