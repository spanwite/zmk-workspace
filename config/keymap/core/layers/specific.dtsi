ZMK_LAYER(mehs,
// ╭──────────────────┬──────────────────┬──────────────────┬──────────────────┬──────────────────┬──────────────────╮   ╭──────────────────┬──────────────────┬──────────────────┬──────────────────┬──────────────────┬──────────────────╮
     XXX                XXX                Y_MEH(W)        Y_MEH(E)        Y_MEH(R)        Y_MEH(T)            Y_MEH(Y)        Y_MEH(U)        Y_MEH(I)        Y_MEH(O)        XXX                XXX 
// ├──────────────────├──────────────────┼──────────────────┼──────────────────┼──────────────────┼──────────────────┤   ├──────────────────├──────────────────┼──────────────────┼──────────────────┼──────────────────┼──────────────────┤
     XXX                Y_MEH(A)        Y_MEH(S)        Y_MEH(D)        Y_MEH(F)        Y_MEH(G)            Y_MEH(H)        Y_MEH(J)        Y_MEH(K)        Y_MEH(L)        Y_MEH(SEMI)     XXX 
// ├──────────────────├──────────────────┼──────────────────┼──────────────────┼──────────────────┼──────────────────┤   ├──────────────────├──────────────────┼──────────────────┼──────────────────┼──────────────────┼──────────────────┤
     ___                Y_MEH(Z)        Y_MEH(X)        Y_MEH(C)        Y_MEH(V)        Y_MEH(B)            Y_MEH(N)        Y_MEH(M)        Y_MEH(COMMA)    Y_MEH(DOT)      Y_MEH(SLASH)    XXX 
// ╰──────────────────┴──────────────────┴──────────────────┼──────────────────┼──────────────────┼──────────────────┤   ├──────────────────├──────────────────┼──────────────────┼──────────────────┴──────────────────┴──────────────────╯
                                                              ___                Y_MEH(LBKT)      ___                    ___               Y_MEH(RBKT)     ___
//                                                          ╰──────────────────┴──────────────────┴──────────────────╯   ╰──────────────────┴──────────────────┴──────────────────╯
)

ZMK_LAYER(lock,
// ╭──────────────────┬──────────────────┬──────────────────┬──────────────────┬──────────────────┬──────────────────╮   ╭──────────────────┬──────────────────┬──────────────────┬──────────────────┬──────────────────┬──────────────────╮
     XXX                XXX                XXX                XXX                XXX                XXX                    XXX                XXX                XXX                XXX                XXX                XXX
// ├──────────────────├──────────────────┼──────────────────┼──────────────────┼──────────────────┼──────────────────┤   ├──────────────────├──────────────────┼──────────────────┼──────────────────┼──────────────────┼──────────────────┤
     XXX                XXX                XXX                XXX                XXX                XXX                    XXX                XXX                XXX                XXX                XXX                XXX
// ├──────────────────├──────────────────┼──────────────────┼──────────────────┼──────────────────┼──────────────────┤   ├──────────────────├──────────────────┼──────────────────┼──────────────────┼──────────────────┼──────────────────┤
     XXX                XXX                XXX                XXX                XXX                XXX                    XXX                XXX                XXX                XXX                XXX                XXX
// ╰──────────────────┴──────────────────┴──────────────────┼──────────────────┼──────────────────┼──────────────────┤   ├──────────────────├──────────────────┼──────────────────┼──────────────────┴──────────────────┴──────────────────╯
                                                              XXX                XXX                XXX                    &mo UNLOCK         XXX                XXX 
//                                                          ╰──────────────────┴──────────────────┴──────────────────╯   ╰──────────────────┴──────────────────┴──────────────────╯
)

ZMK_LAYER(unlock,
// ╭──────────────────┬──────────────────┬──────────────────┬──────────────────┬──────────────────┬──────────────────╮   ╭──────────────────┬──────────────────┬──────────────────┬──────────────────┬──────────────────┬──────────────────╮
     XXX                XXX                XXX                XXX                XXX                XXX                    XXX                XXX                XXX                XXX                XXX                XXX
// ├──────────────────├──────────────────┼──────────────────┼──────────────────┼──────────────────┼──────────────────┤   ├──────────────────├──────────────────┼──────────────────┼──────────────────┼──────────────────┼──────────────────┤
     XXX                XXX                XXX                XXX                XXX                XXX                    XXX                XXX                XXX                XXX                XXX                XXX
// ├──────────────────├──────────────────┼──────────────────┼──────────────────┼──────────────────┼──────────────────┤   ├──────────────────├──────────────────┼──────────────────┼──────────────────┼──────────────────┼──────────────────┤
     XXX                XXX                XXX                XXX                XXX                XXX                    XXX                XXX                XXX                XXX                XXX                XXX
// ╰──────────────────┴──────────────────┴──────────────────┼──────────────────┼──────────────────┼──────────────────┤   ├──────────────────├──────────────────┼──────────────────┼──────────────────┴──────────────────┴──────────────────╯
                                                              XXX                XXX                &to ALPHA              XXX                XXX                XXX 
//                                                          ╰──────────────────┴──────────────────┴──────────────────╯   ╰──────────────────┴──────────────────┴──────────────────╯
)
