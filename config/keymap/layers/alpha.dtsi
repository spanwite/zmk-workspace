ZMK_LAYER(alpha,
// ╭──────────────────┬──────────────────┬──────────────────┬──────────────────┬──────────────────┬──────────────────╮   ╭──────────────────┬──────────────────┬──────────────────┬──────────────────┬──────────────────┬──────────────────╮
     &kp GRAVE          &kp Q              &kp W              &kp E              &kp R              &kp T                  &kp Y              &kp U              &kp I              &kp O              &kp P              &kp LBKT
// ├──────────────────├──────────────────┼──────────────────┼──────────────────┼──────────────────┼──────────────────┤   ├──────────────────├──────────────────┼──────────────────┼──────────────────┼──────────────────┼──────────────────┤
     X_CHNG_LNG         &hml K_HM_4 A      &hml K_HM_3 S      &hml K_HM_2 D      &hml K_HM_1 F      &kp G                  &kp H              &hmr K_HM_1 J      &hmr K_HM_2 K      &hmr K_HM_3 L      &hmr K_HM_4 SEMI   &kp SQT
// ├──────────────────├──────────────────┼──────────────────┼──────────────────┼──────────────────┼──────────────────┤   ├──────────────────├──────────────────┼──────────────────┼──────────────────┼──────────────────┼──────────────────┤
     &to ALPHA          &kp Z              &kp X              &kp C              &kp V              &kp B                  &kp N              &kp M              &kp COMMA          &kp DOT            &kp SLASH          &kp RBKT
// ╰──────────────────┴──────────────────┴──────────────────┼──────────────────┼──────────────────┼──────────────────┤   ├──────────────────├──────────────────┼──────────────────┼──────────────────┴──────────────────┴──────────────────╯
                                                              &lt_caps MEDIA 0   &lt NAV SPACE      &lt_nav FN NAV         &sk LSHFT          &lt_rpt SYM 0      &lt_numrow NUM_ROW NUM_ROW
//                                                          ╰──────────────────┴──────────────────┴──────────────────╯   ╰──────────────────┴──────────────────┴──────────────────╯
)

ZMK_LAYER(shifted,
// ╭──────────────────┬──────────────────┬──────────────────┬──────────────────┬──────────────────┬──────────────────╮   ╭──────────────────┬──────────────────┬──────────────────┬──────────────────┬──────────────────┬──────────────────╮
     &kp LS(GRAVE)      &kp LS(Q)          &kp LS(W)          &kp LS(E)          &kp LS(R)          &kp LS(T)              &kp LS(Y)          &kp LS(U)          &kp LS(I)          &kp LS(O)          &kp LS(P)          &kp LS(LBKT) 
// ├──────────────────├──────────────────┼──────────────────┼──────────────────┼──────────────────┼──────────────────┤   ├──────────────────├──────────────────┼──────────────────┼──────────────────┼──────────────────┼──────────────────┤
     ___                &hml K_HM_4 LS(A)  &hml K_HM_3 LS(S)  &hml K_HM_2 LS(D)  &hml K_HM_1 LS(F)  &kp LS(G)              &kp LS(H)          &hmr K_HM_1 LS(J)  &hmr K_HM_2 LS(K)  &hmr K_HM_3 LS(L)  &hmr K_HM_4 LS(SEMI) &kp LS(SQT) 
// ├──────────────────├──────────────────┼──────────────────┼──────────────────┼──────────────────┼──────────────────┤   ├──────────────────├──────────────────┼──────────────────┼──────────────────┼──────────────────┼──────────────────┤
     ___                &kp LS(Z)          &kp LS(X)          &kp LS(C)          &kp LS(V)          &kp LS(B)              &kp LS(N)          &kp LS(M)          &kp LS(COMMA)      &kp LS(DOT)        &kp SLASH          &kp LS(RBKT)
// ╰──────────────────┴──────────────────┴──────────────────┼──────────────────┼──────────────────┼──────────────────┤   ├──────────────────├──────────────────┼──────────────────┼──────────────────┴──────────────────┴──────────────────╯
                                                              ___                ___                ___                    ___                ___                ___
//                                                          ╰──────────────────┴──────────────────┴──────────────────╯   ╰──────────────────┴──────────────────┴──────────────────╯
)
