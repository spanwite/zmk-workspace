#include <behaviors.dtsi>
#include <behaviors/num_word.dtsi>
#include <dt-bindings/zmk/keys.h>
#include <dt-bindings/zmk/bt.h>
#include <dt-bindings/zmk/mouse.h>
#include <zmk-helpers/helper.h>

#include "aliases/settings.h"
#include "aliases/helpers.h"
#include "aliases/layers.h"
#include "aliases/keys.h"

#include "behaviors/settings.dtsi"
#include "behaviors/alpha.dtsi"
#include "behaviors/symbols.dtsi"
#include "behaviors/smart.dtsi"
#include "behaviors/function.dtsi"

#include "layers/alpha.dtsi"
#include "layers/numbers.dtsi"
#include "layers/symbols.dtsi"
#include "layers/games.dtsi"
#include "layers/specific.dtsi"
#include "layers/navigation.dtsi"
#include "layers/function.dtsi"

#include "combos/main.dtsi"
#include "combos/games.dtsi"

#include "leader/leader.dtsi"
